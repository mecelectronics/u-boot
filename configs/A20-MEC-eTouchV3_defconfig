## configs/A20-MEC-eTouchV3_defconfig
```kconfig
CONFIG_ARM=y
CONFIG_ARCH_SUNXI=y
CONFIG_NR_DRAM_BANKS=1
CONFIG_SPL=y
CONFIG_MACH_SUN7I=y
CONFIG_DRAM_CLK=384
CONFIG_MMC_SUNXI_SLOT_EXTRA=2
CONFIG_USB1_VBUS_PIN=""
CONFIG_USB2_VBUS_PIN=""
CONFIG_I2C1_ENABLE=y
CONFIG_I2C2_ENABLE=y
# CONFIG_VIDEO_HDMI is not set
CONFIG_VIDEO_LCD_MODE="dynamic"
CONFIG_VIDEO_LCD_POWER="PH08"
CONFIG_VIDEO_LCD_RESET="PI00"
CONFIG_VIDEO_LCD_BL_PWM="PB02"
CONFIG_SPL_SPI_SUNXI=y
# CONFIG_SYS_MALLOC_CLEAR_ON_INIT is not set
# CONFIG_FIT is not set
CONFIG_BOOTSTAGE_STASH_SIZE=4096
CONFIG_SD_BOOT=y
CONFIG_BOOTDELAY=1
CONFIG_USE_PREBOOT=y
CONFIG_LOGLEVEL=7
CONFIG_SPL_I2C_SUPPORT=y
# CONFIG_CMD_BDI is not set
CONFIG_CMD_CONFIG=y
# CONFIG_CMD_BOOTD is not set
# CONFIG_BOOTM_NETBSD is not set
# CONFIG_BOOTM_PLAN9 is not set
# CONFIG_BOOTM_RTEMS is not set
# CONFIG_BOOTM_VXWORKS is not set
CONFIG_CMD_BINOP=y
CONFIG_CRC32_VERIFY=y
CONFIG_CMD_EEPROM=y
CONFIG_CMD_MEMINFO=y
CONFIG_CMD_MEMTEST=y
CONFIG_CMD_STRINGS=y
# CONFIG_CMD_FLASH is not set
CONFIG_CMD_READ=y
CONFIG_CMD_SDRAM=y
CONFIG_CMD_SPI=y
CONFIG_DEFAULT_SPI_BUS=2
CONFIG_CMD_BMP=y
CONFIG_CMD_UUID=y
CONFIG_CMD_EXT4_WRITE=y
CONFIG_DEFAULT_DEVICE_TREE="sun7i-a20-mec-etouchv3"
CONFIG_ENV_IS_IN_MMC=y
# CONFIG_NET is not set
CONFIG_REGMAP=y
CONFIG_SYSCON=y
CONFIG_DEVRES=y
CONFIG_DMA=y
CONFIG_SUPPORT_EMMC_BOOT=y
CONFIG_AXP_ALDO3_VOLT=2800
CONFIG_AXP_ALDO3_VOLT_SLOPE_08=y
CONFIG_AXP_ALDO3_INRUSH_QUIRK=y
CONFIG_AXP_ALDO4_VOLT=2800
CONFIG_SPI=y
CONFIG_DM_SPI=y
CONFIG_SPI_SUNXI=y
CONFIG_SOFT_SPI=y
CONFIG_USB_EHCI_HCD=y
CONFIG_USB_OHCI_HCD=y
# CONFIG_USB_GADGET is not set
CONFIG_CFB_CONSOLE_ANSI=y
# CONFIG_WATCHDOG is not set
CONFIG_WDT=y
CONFIG_REGEX=y
CONFIG_LZ4=y
CONFIG_LZMA=y
CONFIG_LZO=y
CONFIG_ZSTD=y
# CONFIG_EFI_LOADER is not set
```
